## embedded/sdkconfig.defaults
```kconfig
# Rust often needs a bit of an extra main task stack size compared to C (the default is 3K)
CONFIG_ESP_MAIN_TASK_STACK_SIZE=20000
CONFIG_ESP32_SPIRAM_SUPPORT=y
CONFIG_SPIRAM=y
CONFIG_SPIRAM_MODE_OCT=y
CONFIG_SPIRAM_SPEED_80M=y
CONFIG_WIFI_LWIP_ALLOCATION_FROM_SPIRAM_FIRST=y
CONFIG_OPTIMIZATION_ASSERTIONS_ENABLED=y

# Use this to set FreeRTOS kernel tick frequency to 1000 Hz (100 Hz by default).
# This allows to use 1 ms granularity for thread sleeps (10 ms by default).
# CONFIG_FREERTOS_HZ=1000

CONFIG_ESP_SYSTEM_EVENT_TASK_STACK_SIZE=12288
CONFIG_PTHREAD_TASK_STACK_SIZE_DEFAULT=80000
CONFIG_SPIRAM_USE_CAPS_ALLOC=y
CONFIG_SPIRAM_ALLOW_BSS_SEG_EXTERNAL_MEMORY=y
CONFIG_ESP32_DEFAULT_PSRAM_AS_HEAP=y
# CONFIG_SPIRAM_USE_MALLOC=y
CONFIG_SPIRAM_USE=CONFIG_SPIRAM_USE_MALLOC

# Workaround for https://github.com/espressif/esp-idf/issues/7631
#CONFIG_MBEDTLS_CERTIFICATE_BUNDLE=n
#CONFIG_MBEDTLS_CERTIFICATE_BUNDLE_DEFAULT_FULL=n
CONFIG_BLE_MESH_FREERTOS_STATIC_ALLOC=y
```
